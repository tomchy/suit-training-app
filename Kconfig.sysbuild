## Kconfig.sysbuild
```kconfig
#
# Copyright (c) 2023 Nordic Semiconductor
#
# SPDX-License-Identifier: LicenseRef-Nordic-5-Clause
#

source "${ZEPHYR_BASE}/share/sysbuild/Kconfig"

config NRF_DEFAULT_IPC_RADIO
	default y

config SUIT_BUILD_FLASH_COMPANION
	default y

config SUIT_BUILD_RECOVERY
	default y
```
